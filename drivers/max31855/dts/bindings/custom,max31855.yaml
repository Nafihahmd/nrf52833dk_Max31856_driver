## drivers/max31855/dts/bindings/custom,max31855.yaml
```yaml
# Copyright (c) 2020, Marco Peter
# SPDX-License-Identifier: Apache-2.0

description: max31856 SPI-based cold-junction compensated thermocouple-to-digital converter.

compatible: "custom,max31855"

include: [sensor-device.yaml, spi-device.yaml]
```

## drivers/max31855/zephyr/Kconfig
```kconfig
# MAX31855 custom driver options 

# Copyright (c) 2019 Nordic Semiconductor
# SPDX-License-Identifier: Apache-2.0

menuconfig CUSTOM_MAX31855
	bool "MAX31855 display driver"
	default y
	select SPI
    help
      Enable support for the custom MAX31855 driver.
```

## drivers/max31856/dts/bindings/custom,max31856.yaml
```yaml
# Copyright (c) 2020, Marco Peter
# SPDX-License-Identifier: Apache-2.0

description: max31856 SPI-based cold-junction compensated thermocouple-to-digital converter.

compatible: "custom,max31856"

include: [sensor-device.yaml, spi-device.yaml]
properties:
  thermocouple-type:
    type: int
    required: true
    description: |
      Thermocouple type (0=B, 1=E, 2=J, 3=K, 4=N, 5=R, 6=S, 7=T)
      
  averaging:
    type: int
    required: false
    default: 0
    description: |
      Averaging setting (0=1x, 1=2x, 2=4x, 3=8x, 4=16x)
      
  filter-50hz:
    type: boolean
    required: false
    description: |
      Enable 50Hz noise rejection (default 60Hz)

  use-external-cj:
    type: boolean
    required: false
    description: |
      Use external cold-junction sensor
      
  operating-mode:
    type: int
    required: false
    default: 0
    description: |
      Operation mode (0=auto, 1=one-shot)
```

## drivers/max31856/zephyr/Kconfig
```kconfig
# MAX31855 custom driver options 

# Copyright (c) 2019 Nordic Semiconductor
# SPDX-License-Identifier: Apache-2.0

menuconfig CUSTOM_MAX31856
	bool "MAX31855 display driver"
	default y
	select SPI
    help
      Enable support for the custom MAX31856 driver.
config MAX31856_FAULT_TRIGGER
    bool "Enable fault trigger support for MAX31856"
    depends on CUSTOM_MAX31856
    help
      Enable fault trigger support for MAX31856 data ready and fault detection.
config MAX31856_DRDY_TRIGGER
    bool "Enable data ready trigger support for MAX31856"
    depends on CUSTOM_MAX31856
    help
      Enable data ready trigger support for MAX31856.
config MAX31856_USE_EXTERNAL_CJ
    bool "Enable external cold junction sensor"
    depends on CUSTOM_MAX31856
    help
      Use an external temperature sensor for cold junction compensation.

config MAX31856_EXTERNAL_CJ_SHT4X
    bool "Use SHT4x as external cold junction sensor"
    depends on MAX31856_USE_EXTERNAL_CJ && SHT4X
    default y
    help
      Use SHT4x temperature sensor for cold junction compensation.
```
